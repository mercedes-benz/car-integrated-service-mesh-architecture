AUTOSAR XML (schema 00050)
package /RB/VRTE/Executables
  executable comd: reporting-behavior=REPORTS-EXECUTION-STATE
    root sw component prototype comd_RootSwComponent: application-type=AraCM_Method_Benchmark_Component
package /RB/VRTE/Processes
  process comd_A: executable=comd, state-dependent-startup-config{function-group-state=[ModeDeclarationGroupPrototype_0.Restart, ModeDeclarationGroupPrototype_0.Shutdown, ModeDeclarationGroupPrototype_0.Startup], resource-group=ResourceGroup_0, startup-config=comd_StartupConfigSet_comd_StartupConfig}
  process comd_B: executable=comd, state-dependent-startup-config{function-group-state=[ModeDeclarationGroupPrototype_1.Restart, ModeDeclarationGroupPrototype_1.Shutdown, ModeDeclarationGroupPrototype_1.Startup], resource-group=ResourceGroup_1, startup-config=comd_B_StartupConfigSet_comd_B_StartupConfig}
package /RB/VRTE/StartupConfigSets
  startup config comd_StartupConfigSet_comd_StartupConfig: timeout={enter-timeout-value=10.0, exit-timeout-value=10.0}
    environment-variables:
      key=LD_LIBRARY_PATH, value=/lib:/usr/lib:/opt/vrte/lib
      key=DSOMEIP_CONFIGURATION, value=/opt/vrte/rb-com/etc/MachineDesign_A_someip.json
      key=ECUCFG_ENV_VAR_ROOTFOLDER, value=/opt/vrte/rb-com/etc/ecu-cfg
      key=DLT_PIPE_DIR, value=/opt/vrte/dev-aap-dlt/data/dlt-sockets/dltpipes
  startup config comd_B_StartupConfigSet_comd_B_StartupConfig: timeout={enter-timeout-value=10.0, exit-timeout-value=10.0}
    environment-variables:
      key=LD_LIBRARY_PATH, value=/lib:/usr/lib:/opt/vrte/lib
      key=DSOMEIP_CONFIGURATION, value=/opt/vrte/rb-com/etc/MachineDesign_B_someip.json
      key=ECUCFG_ENV_VAR_ROOTFOLDER, value=/opt/vrte/rb-com/etc/ecu-cfg
      key=DLT_PIPE_DIR, value=/opt/vrte/dev-aap-dlt/data/dlt-sockets/dltpipes
package /RB/VRTE/ProcessToMachineMappings
  process to machine mapping set comd_ExecutionManifest_ProcessToMachineMappingSet
    process to machine mapping comd_Machine_A_Mapping: machine=Machine_A, persistency-central-storage-uri=/opt/vrte/usr/str-metadata, process=comd_A
    process to machine mapping comd_B_Machine_B_Mapping: machine=Machine_B, persistency-central-storage-uri=/opt/vrte/usr/str-metadata, process=comd_B
package /RB/VRTE/DltLogSinks
  dlt log sink comd_Remote: category=DLT_LOGSINK_REMOTE, default-log-threshold=DEBUG
package /RB/VRTE/DltContexts
  dlt context COM_B_DltContext: context-id=SIGW
  dlt context comd_A_DltContext: context-id=pSOM
  dlt context comd_B_DltContext: context-id=pSOM
package /RB/VRTE/DltContextToPortPrototypeMappings
  dlt log sink to port prototype mapping comd_DltContext_comd_A_dltMapping: dlt-context=comd_A_DltContext, dlt-log-sink=comd_Remote, process=comd_A
  dlt log sink to port prototype mapping comd_B_DltContext_comd_B_dltMapping: dlt-context=comd_B_DltContext, dlt-log-sink=comd_Remote, process=comd_B
package /RB/VRTE/DltApplicationToProcessMappings
  dlt application to process mapping comd_DltAppProcessMapping: dlt-application=COM_A_DltApp, process=comd_A
  dlt application to process mapping comd_B_DltApplicationMapping: dlt-application=COM_B_DltApp, process=comd_B
