AUTOSAR XML (schema 00050)
package /RB/VRTE/Executables
  executable arapipcd: reporting-behavior=REPORTS-EXECUTION-STATE
    root sw component prototype arapipcd_RootSwComponent: application-type=AraCM_Method_Benchmark_Component
package /RB/VRTE/Processes
  process Arapipcd_A: executable=arapipcd, state-dependent-startup-config{function-group-state=[ModeDeclarationGroupPrototype_0.Restart, ModeDeclarationGroupPrototype_0.Shutdown, ModeDeclarationGroupPrototype_0.Startup], resource-group=ResourceGroup_0, startup-config=arapipcd_StartupConfigSet_arapipcd_StartupConfig}
  process Arapipcd_B: executable=arapipcd, state-dependent-startup-config{function-group-state=[ModeDeclarationGroupPrototype_1.Restart, ModeDeclarationGroupPrototype_1.Shutdown, ModeDeclarationGroupPrototype_1.Startup], resource-group=ResourceGroup_1, startup-config=arapipcd_B_StartupConfigSet_arapipcd_B_StartupConfig}
package /RB/VRTE/StartupConfigSets
  startup config arapipcd_StartupConfigSet_arapipcd_StartupConfig: environment-variables=tag-with-optional-value={key=LD_LIBRARY_PATH, value=/lib:/usr/lib:/opt/vrte/lib}, timeout={enter-timeout-value=10.0, exit-timeout-value=10.0}
  startup config arapipcd_B_StartupConfigSet_arapipcd_B_StartupConfig: environment-variables=tag-with-optional-value={key=LD_LIBRARY_PATH, value=/lib:/usr/lib:/opt/vrte/lib}, timeout={enter-timeout-value=10.0, exit-timeout-value=10.0}
package /RB/VRTE/ProcessToMachineMappings
  process to machine mapping set arapipcd_ExecutionManifest_ProcessToMachineMappingSet
    process to machine mapping RouDi_Machine_A_Mapping: machine=Machine_A, persistency-central-storage-uri=/opt/vrte/usr/str-metadata, process=Arapipcd_A
    process to machine mapping RouDi_B_Machine_B_Mapping: machine=Machine_B, persistency-central-storage-uri=/opt/vrte/usr/str-metadata, process=Arapipcd_B
