AUTOSAR XML (schema 00050)
package /RB/VRTE/ServiceInterfaceDeployments
  someip service interface deployment Method: service-interface=AraCM_Method_Benchmark, service-interface-id=11, service-interface-version={major-version=1, minor-version=0}
    someip method deployment MethodIO: method=MethodIO, method-id=12, transport-protocol=UDP
package /RB/VRTE/ServiceInstances
  provided someip service instance MachineDesign_A_PSSI: service-interface-deployment=Method, sd-server-config=MachineDesign_A_SSDSSIC, service-instance-id=34343
  required someip service instance MachineDesign_B_RSSI: service-interface-deployment=Method, required-minor-version=0, required-service-instance-id=34343, sd-client-config=MachineDesign_B_SSDCSIC, version-driven-find-behavior=MINIMUM-MINOR-VERSION
package /RB/VRTE/SomeipSdTimingConfigs
  someip sd server service instance config MachineDesign_A_SSDSSIC: initial-offer-behavior={initial-delay-max-value=1.0, initial-delay-min-value=0.1, initial-repetitions-base-delay=0.2, initial-repetitions-max=3}, offer-cyclic-delay=10.0, request-response-delay={max-value=10.0, min-value=1.0}, service-offer-time-to-live=50
  someip sd client service instance config MachineDesign_B_SSDCSIC: initial-find-behavior={initial-delay-max-value=1.0, initial-delay-min-value=0.1, initial-repetitions-base-delay=0.2, initial-repetitions-max=3}, service-find-time-to-live=100
package /RB/VRTE/ServiceInstanceToMachineMappings
  someip service instance to machine mapping MachineDesign_A_SSITMM: communication-connector=MachineDesign_A_ECC, service-instance=MachineDesign_A_PSSI, udp-port=MachineDesign_A_SSITMM_udpPort_5000
  someip service instance to machine mapping MachineDesign_B_SSITMM: communication-connector=MachineDesign_B_ECC, service-instance=MachineDesign_B_RSSI, udp-port=MachineDesign_B_SSITMM_udpPort_5000
package /RB/VRTE/ServiceInstanceToPortPrototypeMappings
  service instance to port prototype mapping MachineDesign_A_PSSI_PPort: port-prototype=Publisher_RootSwComponent.PPort, process=Publisher_Process, service-instance=MachineDesign_A_PSSI
  service instance to port prototype mapping MachineDesign_B_RSSI_RPort: port-prototype=Subscriber_RootSwComponent.RPort, process=Subscriber_Process, service-instance=MachineDesign_B_RSSI
