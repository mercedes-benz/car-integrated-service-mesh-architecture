AUTOSAR XML (schema 00050)
package /MachineDesign_A
  machine design MachineDesign_A: service-discovery-configs=someip-service-discovery={multicast-sd-ip-address=Multicast_A, someip-service-discovery-port=30490}
    ethernet communication connector MachineDesign_A_ECC: network-endpoint=NetworkEndpoint_A, unicast-network-endpoint=NetworkEndpoint_A
      ap application endpoint MachineDesign_A_SSITMM_udpPort_5000: tp-configuration=udp-tp=udp-tp-port=port-number=5000
