AUTOSAR XML (schema 00050)
package /MachineDesigns
  machine design MachineDesign_B: service-discovery-configs=someip-service-discovery={multicast-sd-ip-address=Multicast_B, someip-service-discovery-port=30490}
    ethernet communication connector MachineDesign_B_ECC: network-endpoint=NetworkEndpoint_B, unicast-network-endpoint=NetworkEndpoint_B
      ap application endpoint MachineDesign_B_SSITMM_udpPort_5000: tp-configuration=udp-tp=udp-tp-port=port-number=5000
