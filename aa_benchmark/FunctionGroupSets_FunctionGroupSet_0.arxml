AUTOSAR XML (schema 00050)
package /FunctionGroupSets
  function group set FunctionGroupSet_0
    function-groups:
      mode declaration group prototype ModeDeclarationGroupPrototype_0: type=MachineFG
      mode declaration group prototype ModeDeclarationGroupPrototype_1: type=MachineFG
