AUTOSAR XML (schema 00050)
package /Machines
  machine Machine_B: machine-design=MachineDesign_B, trusted-platform-executable-launch-behavior=NO-TRUSTED-PLATFORM-SUPPORT
    module-instantiations:
      os module instantiation OsModuleInstantiation_1
        resource group ResourceGroup_1: cpu-usage=0, mem-usage=0
      log and trace instantiation LogAndTraceInstatiation_B: dlt-ecu=ECUB, log-sink=[Subscriber_Console, Subscriber_Remote, EXM_Remote, EXM_Console]
    processor Processor_1
      processor core Core_0: core-id=0
      processor core Core_1: core-id=1
package /RB/VRTE/DltEcus
  dlt ecu ECUB: ecu-id=ECUB
    dlt application SUB_DltApp: application-id=SAPP
    dlt application COM_B_DltApp: application-description=DltApplication for comd_B, application-id=COM
    dlt application EXM_B_DltApp: application-description=EXMB DltApplication, application-id=EXMB
