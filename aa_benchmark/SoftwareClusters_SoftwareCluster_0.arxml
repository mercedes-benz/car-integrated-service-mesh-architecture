AUTOSAR XML (schema 00050)
package /SoftwareClusters
  software cluster SoftwareCluster_0: category=PLATFORM_CATEGORY, claimed-function-group=ModeDeclarationGroupPrototype_0, contained-process=[comd_A, Arapipcd_A, Publisher_Process, DLT_A], design=SoftwareClusterDesign_0, module-instantiation=LogAndTraceInstatiation_A, vendor-signature=CryptoServiceCertificate_0, vendor-id=11, version=1.0.0-alpha+001
  crypto service certificate CryptoServiceCertificate_0
