AUTOSAR XML (schema 00050)
package /RB/VRTE/Executables
  executable DLT: reporting-behavior=REPORTS-EXECUTION-STATE
package /RB/VRTE/Processes
  process DLT_A: executable=DLT, state-dependent-startup-config{function-group-state=[ModeDeclarationGroupPrototype_0.Restart, ModeDeclarationGroupPrototype_0.Shutdown, ModeDeclarationGroupPrototype_0.Startup], resource-group=ResourceGroup_0, startup-config=DLT_StartupConfig}
  process DLT_B: executable=DLT, state-dependent-startup-config{function-group-state=[ModeDeclarationGroupPrototype_1.Restart, ModeDeclarationGroupPrototype_1.Shutdown, ModeDeclarationGroupPrototype_1.Startup], resource-group=ResourceGroup_1, startup-config=DLT_B_StartupConfig}
package /RB/VRTE/StartupConfigs
  startup config DLT_StartupConfig: process-arguments=[-c, /opt/vrte/usr/etc/dlt_a.conf, -t, /opt/vrte/dev-aap-dlt/data/dlt-sockets/dltpipes], timeout={enter-timeout-value=100.0, exit-timeout-value=100.0}
    environment-variables:
      key=LD_LIBRARY_PATH, value=/lib:/usr/lib:/opt/vrte/lib
      key=ECUCFG_ENV_VAR_ROOTFOLDER, value=/opt/vrte/dev-aap-dlt/etc/ecu-cfg
  startup config DLT_B_StartupConfig: process-arguments=[-c, /opt/vrte/usr/etc/dlt_b.conf, -t, /opt/vrte/dev-aap-dlt/data/dlt-sockets/dltpipes], timeout={enter-timeout-value=100.0, exit-timeout-value=100.0}
    environment-variables:
      key=LD_LIBRARY_PATH, value=/lib:/usr/lib:/opt/vrte/lib
      key=ECUCFG_ENV_VAR_ROOTFOLDER, value=/opt/vrte/dev-aap-dlt/etc/ecu-cfg
package /RB/VRTE/ProcessToMachineMappings
  process to machine mapping set DLT_ExecutionManifest_ProcessToMachineMappingSet
    process to machine mapping DLT_A_Machine_A_Mapping: machine=Machine_A, persistency-central-storage-uri=/opt/vrte/usr/str-metadata, process=DLT_A
    process to machine mapping DLT_B_Machine_B_Mapping: machine=Machine_B, persistency-central-storage-uri=/opt/vrte/usr/str-metadata, process=DLT_B
package /RB/VRTE/DltLogSinks
  dlt log sink EXM_Remote: category=DLT_LOGSINK_REMOTE, default-log-threshold=INFO
  dlt log sink EXM_Console: category=DLT_LOGSINK_CONSOLE, default-log-threshold=INFO
package /RB/VRTE/DltContexts
  dlt context EXM_A_DltContext: context-id=EXM
  dlt context EXM_B_DltContext: context-id=EXM
package /RB/VRTE/DltContextToPortPrototypeMappings
  dlt log sink to port prototype mapping EXM_A_DltContext_DLT_dltMapping: dlt-context=EXM_A_DltContext, dlt-log-sink=[EXM_Remote, EXM_Console], process=DLT_A
  dlt log sink to port prototype mapping EXM_B_DltContext_DLT_B_dltMapping: dlt-context=EXM_B_DltContext, dlt-log-sink=[EXM_Remote, EXM_Console], process=DLT_B
package /RB/VRTE/DltApplicationToProcessMappings
  dlt application to process mapping EXM_A_DltProcessMapping: dlt-application=EXM_A_DltApp, process=DLT_A
  dlt application to process mapping EXM_B_DltProcessMapping: dlt-application=EXM_B_DltApp, process=DLT_B
