AUTOSAR XML (schema 00050)
package /CommunicationClusters
  ethernet cluster EthernetCluster_1
    ethernet physical channel EthernetPhysicalChannel_0
      network endpoint NetworkEndpoint_B: network-endpoint-addresses=ipv-4-configuration={ipv-4-address=172.31.26.249, network-mask=255.255.240.0}
      network endpoint Multicast_B: network-endpoint-addresses=ipv-4-configuration={ip-address-keep-behavior=STORE-PERSISTENTLY, ipv-4-address=224.244.224.245, network-mask=255.255.240.0}
