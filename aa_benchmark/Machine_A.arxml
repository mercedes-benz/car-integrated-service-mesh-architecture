AUTOSAR XML (schema 00050)
package /Machine_A
  machine Machine_A: machine-design=MachineDesign_A, trusted-platform-executable-launch-behavior=NO-TRUSTED-PLATFORM-SUPPORT
    module-instantiations:
      os module instantiation OsModuleInstantiation_0
        resource group ResourceGroup_0: cpu-usage=0, mem-usage=0
      log and trace instantiation LogAndTraceInstatiation_A: dlt-ecu=ECUA, log-sink=[Publisher_Console, Publisher_Remote, comd_Remote, EXM_Remote, EXM_Console]
    processor Processor_0
      processor core Core_0: core-id=0
      processor core Core_1: core-id=1
package /RB/VRTE/DltEcus
  dlt ecu ECUA: ecu-id=ECUA
    dlt application PUB_DltApp: application-description=Publiisher DltAppl, application-id=PAPP
    dlt application COM_A_DltApp: application-description=DltApplication for comd_A, application-id=SIGW
    dlt application EXM_A_DltApp: application-description=EXMA DltApplication, application-id=EXMA
