AUTOSAR XML (schema 00050)
package /RB/VRTE/Executables
  executable Subscriber: reporting-behavior=DOES-NOT-REPORT-EXECUTION-STATE
    root sw component prototype Subscriber_RootSwComponent: application-type=AraCM_Method_Benchmark_Component
package /RB/VRTE/Processes
  process Subscriber_Process: executable=Subscriber, state-dependent-startup-config{function-group-state=[ModeDeclarationGroupPrototype_1.Restart, ModeDeclarationGroupPrototype_1.Shutdown, ModeDeclarationGroupPrototype_1.Startup], resource-group=ResourceGroup_1, startup-config=Subscriber_StartupConfig}
package /RB/VRTE/StartupConfigs
  startup config Subscriber_StartupConfig: termination-behavior=PROCESS-IS-SELF-TERMINATING, timeout={enter-timeout-value=100.0, exit-timeout-value=100.0}
    environment-variables:
      key=LD_LIBRARY_PATH, value=/lib:/usr/lib:/opt/vrte/lib
      key=ECUCFG_ENV_VAR_ROOTFOLDER, value=/opt/vrte/usr/etc/ecu-cfg/processes/Subscriber
      key=DLT_PIPE_DIR, value=/opt/vrte/dev-aap-dlt/data/dlt-sockets/dltpipes
package /RB/VRTE/ProcessToMachineMappings
  process to machine mapping set Subscriber_ExecutionManifest_ProcessToMachineMappingSet
    process to machine mapping Subscriber_Machine_B_Mapping: machine=Machine_B, persistency-central-storage-uri=/opt/vrte/usr/str-metadata, process=Subscriber_Process
package /RB/VRTE/DltContexts
  dlt context SUB: context-id=SUB
package /RB/VRTE/DltContextToPortPrototypeMappings
  dlt log sink to port prototype mapping SUB_Subscriber_Process_dltMapping: dlt-context=SUB, dlt-log-sink=[Subscriber_Console, Subscriber_Remote], process=Subscriber_Process
package /RB/VRTE/DltLogSinks
  dlt log sink Subscriber_Console: category=DLT_LOGSINK_CONSOLE, default-log-threshold=INFO
  dlt log sink Subscriber_Remote: category=DLT_LOGSINK_REMOTE, default-log-threshold=INFO
package /RB/VRTE/DltApplicationToProcessMappings
  dlt application to process mapping SUB_DltApplicationMapping: dlt-application=SUB_DltApp, process=Subscriber_Process
