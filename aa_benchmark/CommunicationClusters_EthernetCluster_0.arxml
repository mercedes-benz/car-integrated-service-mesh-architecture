AUTOSAR XML (schema 00050)
package /CommunicationClusters
  ethernet cluster EthernetCluster_0
    ethernet physical channel EthernetPhysicalChannel_0
      network endpoint NetworkEndpoint_A: network-endpoint-addresses=ipv-4-configuration={ipv-4-address=172.31.23.213, ipv-4-address-source=FIXED, network-mask=255.255.240.0}
      network endpoint Multicast_A: network-endpoint-addresses=ipv-4-configuration={ip-address-keep-behavior=STORE-PERSISTENTLY, ipv-4-address=224.244.224.245, network-mask=255.255.240.0}
